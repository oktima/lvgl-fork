## src/draw/opengles/Kconfig
```kconfig
config LV_USE_DRAW_OPENGLES
	bool "OpenGL ES renderer"
	default n
	select LV_USE_OPENGLES
	select LV_DRAW_HAS_3D_SUPPORT
	select LV_DRAW_DISABLE_TILED_RENDERING
	help
		Draw with OpenGL ES, keeping rendered widgets and images as GPU textures.

if LV_USE_DRAW_OPENGLES

config LV_DRAW_OPENGLES_TEXTURE_CACHE_SIZE
	int "Texture cache size (bytes)"
	default 16384
	help
		Maximum total size in bytes of the textures kept in the cache
		(width * height * 4 per texture). A bigger cache means fewer redraws
		but more GPU memory.

endif
```
